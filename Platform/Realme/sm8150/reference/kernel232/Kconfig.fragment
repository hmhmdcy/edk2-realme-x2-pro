## Platform/Realme/sm8150/reference/kernel232/Kconfig.fragment
```kconfig
config RESET_REALME_RMX1931_PM8008
	tristate "Realme RMX1931 camera PM8008 resets"
	depends on OF && GPIOLIB && RESET_CONTROLLER
	help
	  Own P/Q reset GPIOs and hold P while Q changes its I2C address.
```
